## prj.conf
```kconfig
CONFIG_NETWORKING=y
CONFIG_NET_LOG=y
CONFIG_LOG=y
CONFIG_NET_IPV6=y
CONFIG_NET_IPV4=y
CONFIG_NET_DHCPV4=n
CONFIG_NET_UDP=y
CONFIG_NET_TCP=y
CONFIG_NET_STATISTICS=y
CONFIG_NET_STATISTICS_USER_API=y

CONFIG_TEST_RANDOM_GENERATOR=y

CONFIG_NET_PKT_RX_COUNT=32
CONFIG_NET_PKT_TX_COUNT=32
CONFIG_NET_BUF_RX_COUNT=32
CONFIG_NET_BUF_TX_COUNT=32
CONFIG_NET_IF_UNICAST_IPV6_ADDR_COUNT=5
CONFIG_NET_IF_MCAST_IPV6_ADDR_COUNT=5
CONFIG_NET_IF_UNICAST_IPV4_ADDR_COUNT=1
CONFIG_NET_MAX_CONTEXTS=10

CONFIG_INIT_STACKS=y
CONFIG_PRINTK=y
CONFIG_NET_SHELL=y

# Ethernet is needed for gPTP
CONFIG_NET_L2_ETHERNET=y

CONFIG_NET_CONFIG_NEED_IPV6=y
CONFIG_NET_CONFIG_NEED_IPV4=y
CONFIG_NET_CONFIG_SETTINGS=y

# There will be one network interface. If you enable
# VLAN in overlay-vlan.conf, then gPTP will create three
# network interfaces.

# First ethernet interface will use these settings
CONFIG_NET_CONFIG_MY_IPV6_ADDR="2001:db8::1"
CONFIG_NET_CONFIG_PEER_IPV6_ADDR="2001:db8::2"
CONFIG_NET_CONFIG_MY_IPV4_ADDR="192.0.2.1"
CONFIG_NET_CONFIG_PEER_IPV4_ADDR="192.0.2.2"

# gPTP settings
CONFIG_NET_GPTP=y
CONFIG_NET_GPTP_STATISTICS=y
CONFIG_NET_GPTP_GM_CAPABLE=y

# How many traffic classes to enable
CONFIG_NET_TC_TX_COUNT=6
CONFIG_NET_TC_RX_COUNT=4

# Enable priority support in net_context
CONFIG_NET_CONTEXT_PRIORITY=y

CONFIG_LOG_MODE_DEFERRED=y

CONFIG_CBPRINTF_FP_SUPPORT=y
```

## boards/frdm_k64f.conf
```kconfig
# MCUX driver settings
CONFIG_ETH_MCUX=y
CONFIG_PTP_CLOCK_MCUX=y
CONFIG_NET_CONFIG_MY_IPV6_ADDR="2001:db8::2"
CONFIG_NET_CONFIG_PEER_IPV6_ADDR="2001:db8::1"
CONFIG_NET_CONFIG_MY_IPV4_ADDR="192.0.2.2"
CONFIG_NET_CONFIG_PEER_IPV4_ADDR="192.0.2.1"
CONFIG_CBPRINTF_FP_SUPPORT=y
CONFIG_CBPRINTF_FP_A_SUPPORT=y
CONFIG_CBPRINTF_FP_ALWAYS_A=y
CONFIG_NET_GPTP_NEIGHBOR_PROP_DELAY_THR=1000000
```

## boards/mimxrt1020_evk.conf
```kconfig
# Our configuration
CONFIG_ETH_MCUX=y
CONFIG_PTP_CLOCK_MCUX=y
CONFIG_NET_CONFIG_MY_IPV6_ADDR="2001:db8::1"
CONFIG_NET_CONFIG_PEER_IPV6_ADDR="2001:db8::2"
CONFIG_NET_CONFIG_MY_IPV4_ADDR="192.0.2.1"
CONFIG_NET_CONFIG_PEER_IPV4_ADDR="192.0.2.2"
CONFIG_CBPRINTF_FP_SUPPORT=y
CONFIG_CBPRINTF_FP_A_SUPPORT=y
CONFIG_CBPRINTF_FP_ALWAYS_A=y
CONFIG_NET_GPTP_NEIGHBOR_PROP_DELAY_THR=1000000
```

## boards/mimxrt1050_evk.conf
```kconfig
CONFIG_PTP_CLOCK_MCUX=y
CONFIG_NET_CONFIG_MY_IPV6_ADDR="2001:db8::2"
CONFIG_NET_CONFIG_PEER_IPV6_ADDR="2001:db8::1"
CONFIG_NET_CONFIG_MY_IPV4_ADDR="192.0.2.2"
CONFIG_NET_CONFIG_PEER_IPV4_ADDR="192.0.2.1"
CONFIG_ETH_MCUX_PTP_CLOCK_SRC_HZ=25000000
CONFIG_ETH_MCUX_RX_BUFFERS=4
CONFIG_ETH_MCUX_TX_BUFFERS=4
CONFIG_NET_GPTP_STATISTICS=y
CONFIG_NEWLIB_LIBC_FLOAT_PRINTF=y
CONFIG_MINIMAL_LIBC_LL_PRINTF=y
CONFIG_NEWLIB_LIBC=y
```

## src/main.c
```c
/*
 * Copyright (c) 2018 Intel Corporation.
 *
 * SPDX-License-Identifier: Apache-2.0
 */

#include <logging/log.h>
LOG_MODULE_REGISTER(net_gptp_sample, LOG_LEVEL_DBG);

#include <zephyr.h>
#include <errno.h>

#include <net/net_core.h>
#include <net/net_l2.h>
#include <net/net_if.h>
#include <net/ethernet.h>
#include <net/gptp.h>

/*USER BEGIN INCLUDES*/
#include <net/ptp_time.h>
#include <sys/printk.h>
#include <sys/util.h>
/*USER END INCLUDES*/

extern void init_testing(void);

static struct gptp_phase_dis_cb phase_dis;

/*USER BEGIN VARIABLES*/
static struct net_ptp_time slave_time;
//struct gptp_clk_src_time_invoke_params src_time_invoke_parameters;
bool gm_present;
int status;
/*USER END VARIABLES*/

#if defined(CONFIG_NET_GPTP_VLAN)
/* User data for the interface callback */
struct ud {
	struct net_if *first;
	struct net_if *second;
	struct net_if *third;
};

static void iface_cb(struct net_if *iface, void *user_data)
{
	struct ud *ud = user_data;

	if (net_if_l2(iface) != &NET_L2_GET_NAME(ETHERNET)) {
		return;
	}

	if (!ud->first) {
		ud->first = iface;
		return;
	}

	if (!ud->second) {
		ud->second = iface;
		return;
	}

	if (!ud->third) {
		ud->third = iface;
		return;
	}
}

static int setup_iface(struct net_if *iface, const char *ipv6_addr,
		       const char *ipv4_addr, uint16_t vlan_tag)
{
	struct net_if_addr *ifaddr;
	struct in_addr addr4;
	struct in6_addr addr6;
	int ret;

	ret = net_eth_vlan_enable(iface, vlan_tag);
	if (ret < 0) {
		LOG_ERR("Cannot enable VLAN for tag %d (%d)", vlan_tag, ret);
	}

	if (net_addr_pton(AF_INET6, ipv6_addr, &addr6)) {
		LOG_ERR("Invalid address: %s", ipv6_addr);
		return -EINVAL;
	}

	ifaddr = net_if_ipv6_addr_add(iface, &addr6, NET_ADDR_MANUAL, 0);
	if (!ifaddr) {
		LOG_ERR("Cannot add %s to interface %p", ipv6_addr, iface);
		return -EINVAL;
	}

	if (net_addr_pton(AF_INET, ipv4_addr, &addr4)) {
		LOG_ERR("Invalid address: %s", ipv4_addr);
		return -EINVAL;
	}

	ifaddr = net_if_ipv4_addr_add(iface, &addr4, NET_ADDR_MANUAL, 0);
	if (!ifaddr) {
		LOG_ERR("Cannot add %s to interface %p", ipv4_addr, iface);
		return -EINVAL;
	}

	LOG_DBG("Interface %p VLAN tag %d setup done.", iface, vlan_tag);

	return 0;
}

static int init_vlan(void)
{
	struct ud ud;
	int ret;

	(void)memset(&ud, 0, sizeof(ud));

	net_if_foreach(iface_cb, &ud);

	/* This sample has two VLANs. For the second one we need to manually
	 * create IP address for this test. But first the VLAN needs to be
	 * added to the interface so that IPv6 DAD can work properly.
	 */
	ret = setup_iface(ud.second,
			  CONFIG_NET_SAMPLE_IFACE2_MY_IPV6_ADDR,
			  CONFIG_NET_SAMPLE_IFACE2_MY_IPV4_ADDR,
			  CONFIG_NET_SAMPLE_IFACE2_VLAN_TAG);
	if (ret < 0) {
		return ret;
	}

	ret = setup_iface(ud.third,
			  CONFIG_NET_SAMPLE_IFACE3_MY_IPV6_ADDR,
			  CONFIG_NET_SAMPLE_IFACE3_MY_IPV4_ADDR,
			  CONFIG_NET_SAMPLE_IFACE3_VLAN_TAG);
	if (ret < 0) {
		return ret;
	}

	return 0;
}
#endif /* CONFIG_NET_GPTP_VLAN */

static void gptp_phase_dis_cb(uint8_t *gm_identity,
			      uint16_t *time_base,
			      struct gptp_scaled_ns *last_gm_ph_change,
			      double *last_gm_freq_change)
{
	char output[sizeof("xx:xx:xx:xx:xx:xx:xx:xx")];
	static uint8_t id[8];

	if (memcmp(id, gm_identity, sizeof(id))) {
		memcpy(id, gm_identity, sizeof(id));

		LOG_DBG("GM %s last phase %d.%" PRId64 "",
			log_strdup(gptp_sprint_clock_id(gm_identity, output,
							sizeof(output))),
			last_gm_ph_change->high,
			last_gm_ph_change->low);
	}
}

static int init_app(void)
{
#if defined(CONFIG_NET_GPTP_VLAN)
	if (init_vlan() < 0) {
		LOG_ERR("Cannot setup VLAN");
	}
#endif

	gptp_register_phase_dis_cb(&phase_dis, gptp_phase_dis_cb);

	return 0;
}

void main(void)
{
	int32_t max_lapse_diff_ns = 0, min_lapse_diff_ns = 0;
	int64_t lapse_diff_ns;
	uint64_t current_timelapse_ns;
	uint32_t looptime_ms;
	uint64_t prevsecond = 0;
    uint64_t prevnanosecond = 0;
	uint32_t lapse_diff_err_ns, lapse_diff_err_count = 0;
	uint32_t report_loops, report_loop = 0;
	int32_t numbertest;

    init_app();
    init_testing();

	/* Configurable parameters */
	looptime_ms = 593; /* Time to sleep for between test loops. In Miliseconds */
	lapse_diff_err_ns = 5000000; /* Loop difference threshold to signal an error, in nanoseconds */

	/* Prepare test loop */	
	min_lapse_diff_ns = looptime_ms * 1000000;
	/* We want preiodic reports coming no faster than 1second apart */
	if (looptime_ms >= 1000) {
		report_loops = 1;
	} else {
		report_loops = 1000 / looptime_ms;
	}

	/* Verify the compiler maximum and minimum values to verify that
	we are comparing limits correctly further on */
	LOG_INF("BEGIN NUMBERTEST");
	numbertest = 0x0;
	LOG_INF("NUMBERTEST 0x0: %d, 0x%X", numbertest, numbertest);
	numbertest = 0xFFFFFFFF;
	LOG_INF("NUMBERTEST 0xFFFFFFFF: %d, 0x%X", numbertest, numbertest);
	numbertest = 0x80000000;
	LOG_INF("NUMBERTEST 0x80000000: %d, 0x%X", numbertest, numbertest);
	numbertest = 0x7FFFFFFF;
	LOG_INF("NUMBERTEST 0x7FFFFFFF: %d, 0x%X", numbertest, numbertest);
	LOG_INF("END NUMBERTEST");

    /* USER BEGIN MAIN.C*/
    while(1){

		/* Extract the gPTP time NOW */
        status=gptp_event_capture(&slave_time, &gm_present);

		/* Make sure we are already received an external time reference */
		if (slave_time.second != 0) {
			/* Time can't go backwards. If we see this happen, it's clearly an error */
			if ((slave_time.second < prevsecond) || ((slave_time.second == prevsecond) && (slave_time.nanosecond < prevnanosecond)))
			{
				LOG_ERR("gptp time ERROR: TIME WENT BACKWARDS!!!!!%u.%u > %u.%u", prevsecond, prevnanosecond, slave_time.second, slave_time.nanosecond);
			}
			else {
				/* Make sure we are in our second loop and we have a previous reference */
				if ((prevsecond != 0) && (prevnanosecond != 0)) {
					/* Calculate how much time passed since the last sample */
					current_timelapse_ns = ((((slave_time.second - prevsecond) * 1000000000) + slave_time.nanosecond) - prevnanosecond);
					/* Calculate real lapse difference against the sleep time */
					lapse_diff_ns = current_timelapse_ns - (looptime_ms * 1000000);
					if (llabs(lapse_diff_ns) < abs(min_lapse_diff_ns))
					{
						/* Register the minimum value */
						/* Take care of value limits */
						if (lapse_diff_ns > 2147483648) {
							min_lapse_diff_ns = 2147483648;
						} else if (lapse_diff_ns < -2147483648) {
							min_lapse_diff_ns = -2147483648;
						} else {
							min_lapse_diff_ns = lapse_diff_ns;
						}
						LOG_WRN("gPTP time: New MIN lapse difference: %d", min_lapse_diff_ns);
					}
					if (llabs(lapse_diff_ns) > abs(max_lapse_diff_ns))
					{
						/* Register the minimum value */
						/* Take care of value limits */
						if (lapse_diff_ns > 2147483648) {
							max_lapse_diff_ns = 2147483648;
						} else if (lapse_diff_ns < -2147483648) {
							max_lapse_diff_ns = -2147483648;
						} else {
							max_lapse_diff_ns = lapse_diff_ns;
						}
						LOG_WRN("gPTP time: New MAX lapse difference: %d", max_lapse_diff_ns);
					}
					/* If the lapse difference is larger than the set limit, increase the error counter */
					if (abs(lapse_diff_ns) > lapse_diff_err_ns) {
						lapse_diff_err_count++;
					}
				}
			}

			/* Control report pacing */
			report_loop++;
			if (report_loop >= report_loops) {
				/* Print report */
				LOG_INF("gPTP time %u.%u", slave_time.second, slave_time.nanosecond);
				LOG_INF("gPTP lapse diff error count (%u ns): %u", lapse_diff_err_ns, lapse_diff_err_count);
				LOG_INF("gPTP max lapse difference: %d | gPTP min lapse difference: %d", max_lapse_diff_ns, min_lapse_diff_ns);
				report_loop = 0;
			}
		}
        prevsecond = slave_time.second;
        prevnanosecond = slave_time.nanosecond;
        k_msleep(looptime_ms); //sleep time in ms
    }
    /* USER END MAIN.C*/
}
```

## src/gptp.c
```c
/*
 * Copyright (c) 2020 Intel Corporation.
 *
 * SPDX-License-Identifier: Apache-2.0
 */

#include <logging/log.h>
LOG_MODULE_DECLARE(net_gptp_sample);

#include <zephyr.h>
#include <errno.h>
#include <stdlib.h>

#include <net/net_core.h>
#include <net/gptp.h>

#include "ethernet/gptp/gptp_messages.h"
#include "ethernet/gptp/gptp_data_set.h"

/*USER BEGIN INCLUDES*/
#include <net/ptp_time.h>
#include <sys/printk.h>
#include <sys/util.h>
/*USER END INCLUDES*/

static int run_duration = CONFIG_NET_SAMPLE_RUN_DURATION;
static struct k_work_delayable stop_sample;
static struct k_sem quit_lock;

/*USER BEGIN VARIABLES*/
static struct net_ptp_time slave_time;

static void stop_handler(struct k_work *work)
{
	ARG_UNUSED(work);

	k_sem_give(&quit_lock);
}

static int get_current_status(void)
{
	struct gptp_domain *domain;
	struct gptp_port_ds *port_ds;
	int ret, port;

	port = 1;

	domain = gptp_get_domain();

	ret = gptp_get_port_data(domain, port, &port_ds,
				 NULL, NULL, NULL, NULL);
	if (ret < 0) {
		LOG_WRN("Cannot get gPTP information for port %d (%d)",
			port, ret);
		return ret;
	}

	if (port != port_ds->port_id.port_number) {
		return -EINVAL;
	}

	switch (GPTP_GLOBAL_DS()->selected_role[port]) {
	case GPTP_PORT_INITIALIZING:
	case GPTP_PORT_FAULTY:
	case GPTP_PORT_DISABLED:
	case GPTP_PORT_LISTENING:
	case GPTP_PORT_PRE_MASTER:
	case GPTP_PORT_PASSIVE:
	case GPTP_PORT_UNCALIBRATED:
		return 0;
	case GPTP_PORT_MASTER:
		return 1;
	case GPTP_PORT_SLAVE:
		return 2;
	}

	return -1;
}

void init_testing(void)
{
	bool gm_present;
	uint64_t prevsecond = 0;
	uint64_t prevnanosecond = 0;
	uint32_t uptime = k_uptime_get_32();
	int ret;
	int status;

	if (run_duration == 0) {
		/* USER BEGIN MAIN.C*/
		while(1){
			ret = get_current_status();
			if (ret != 2){
				status = gptp_event_capture(&slave_time, &gm_present);
				if ( slave_time.second == prevsecond ) {
					if (slave_time.nanosecond == prevnanosecond)
					{
						LOG_ERR("gPTP time ERROR: %llu.%llu != %llu.%llu\n", prevsecond, prevnanosecond, slave_time.second, (uint64_t)slave_time.nanosecond);
					}
				}
				printk("read time %llu.%llu\n", slave_time.second, (uint64_t)slave_time.nanosecond);
				prevsecond = slave_time.second;
				prevnanosecond = slave_time.nanosecond;
			}
			k_msleep(100); //sleep time in ms
		}
	}

	k_sem_init(&quit_lock, 0, K_SEM_MAX_LIMIT);

	k_work_init_delayable(&stop_sample, stop_handler);
	k_work_reschedule(&stop_sample, K_SECONDS(run_duration));

	k_sem_take(&quit_lock, K_FOREVER);

	LOG_INF("Stopping after %u seconds",
		(k_uptime_get_32() - uptime) / 1000);

	/* Try to figure out what is the sync state.
	 * Return:
	 *  <0 - configuration error
	 *   0 - not time sync
	 *   1 - we are MASTER
	 *   2 - we are SLAVE
	 */
	ret = get_current_status();

	exit(ret);
}
```
